/dts-v1/;

#include "sdm450.dtsi"
#include "pmi8940.dtsi"

#include "msm8953-qrd.dtsi"

/ {
	model = "Qualcomm Technologies, Inc. SDM450 + PMI8940 QRD";
	compatible = "qcom,sdm450-qrd", "qcom,sdm450", "qcom,qrd";
	qcom,board-id = <0x1000b 1>;
};

#include "rosy/msm8953-mdss-panels_rosy.dtsi"
#include "rosy/msm8953-camera-sensor-qrd_rosy.dtsi"
#include "rosy/msm8953-pinctrl_rosy.dtsi"
#include "rosy/msm8953-qrd_rosy.dtsi"
#include "rosy/msm8953_rosy.dtsi"
#include "rosy/msm8953-qrd-sku3_rosy.dtsi"
#include "rosy/msm8953-audio_rosy.dtsi"
