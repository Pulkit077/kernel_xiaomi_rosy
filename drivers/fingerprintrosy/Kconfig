## drivers/fingerprintrosy/Kconfig
```kconfig
config FINGERPRINT_ROSY
	tristate "ROSY Fingerprint driver support"
	help
	  Say Y here to enable fingerprint driver support for rosy!

source "drivers/fingerprintrosy/fpcrosy/Kconfig"
source "drivers/fingerprintrosy/goodixrosy/Kconfig"
```

## drivers/fingerprintrosy/fpcrosy/Kconfig
```kconfig
config FINGERPRINT_FPC1020_ROSY
	tristate "FingerPrint Cards fingerprint drvier support"
	depends on FINGERPRINT_ROSY
	help
	  Say Y here to enable fpc1020 fingerprint driver support for rosy!
```

## drivers/fingerprintrosy/goodixrosy/Kconfig
```kconfig
config FINGERPRINT_GF3208_ROSY
	tristate "generic goodix fingerprint driver"
	depends on FINGERPRINT_ROSY
	help
	  Say Y here to enable goodix fingerprint driver support for rosy!
```

## drivers/input/touchscreen/FT8006m/Kconfig
```kconfig
#
# Focaltech Touchscreen driver configuration
#

config TOUCHSCREEN_FT8006M
	tristate "FT8006M touchscreen driver"
	depends on I2C
	default n
	help
	  Say Y here if you have Focaltech touch panel.
	  If unsure, say N.
```
